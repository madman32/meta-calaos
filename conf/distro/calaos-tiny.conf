## conf/distro/calaos-tiny.conf
```bitbake
DISTRO = "calaos-tiny"
DISTRO_NAME = "Calaos Tiny"
DISTRO_VERSION = "v3.0"
BUILDNAME = "Calaos Tiny ${DISTRO_VERSION}"

DISTRO_FEATURES = "alsa ext2 largefile usbhost ${DISTRO_FEATURES_LIBC} keyboard"

USE_NLS="no"


# Use tmpdevfs and the busybox runtime services
VIRTUAL-RUNTIME_dev_manager = ""
VIRTUAL-RUNTIME_login_manager = ""
VIRTUAL-RUNTIME_init_manager = "tiny-init"
VIRTUAL-RUNTIME_keymaps = ""

IMAGE_FSTYPES = "cpio.gz tar.gz"

PREFERRED_VERSION_expedite = "git"
PREFERRED_VERSION_efl = "git"
```

## conf/distro/calaos.conf
```bitbake
DISTRO_NAME = "Calaos"
DISTRO_VERSION = "v3.0"
BUILDNAME = "Calaos ${DISTRO_VERSION}"
PACKAGE_CLASSES = "package_ipk"
DISTRO_FEATURES = "alsa ext2 largefile usbhost wifi xattr zeroconf ${DISTRO_FEATURES_LIBC} systemd keyboard opengl x11"
VIRTUAL-RUNTIME_init_manager = "systemd"
VIRTUAL-RUNTIME_dev_manager = "systemd"

IMAGE_NAME = "${IMAGE_BASENAME}-${MACHINE}-${DISTRO_VERSION}-${DATETIME}"

#Autoload required modules for touchscreen and serial2usb converters
KERNEL_MODULE_AUTOLOAD= "cp210x ft5x-ts ftdi-sio usbserial pl2303 w1 w1_therm"

KERNEL_INITRAMFS = "-initramfs"
#IMAGE_CLASSES += "ddimg_image-calaos"

INITRAMFS_IMAGE = "calaos-os-update"
INITRAMFS_IMAGE_BUNDLE = "1"

# Use hardfp for sunxi boards
DEFAULTTUNE_sun4i = "cortexa8hf-neon"
DEFAULTTUNE_sun5i = "cortexa8hf-neon"

#Do not use mainline uboot and kernel for sunxi boards
PREFERRED_PROVIDER_u-boot_sun4i="u-boot-sunxi"
PREFERRED_PROVIDER_virtual/bootloader_sun4i="u-boot-sunxi"
PREFERRED_PROVIDER_virtual/kernel_sun4i="linux-sunxi"
PREFERRED_PROVIDER_u-boot_sun5i="u-boot-sunxi"
PREFERRED_PROVIDER_virtual/bootloader_sun5i="u-boot-sunxi"
PREFERRED_PROVIDER_virtual/kernel_sun5i="linux-sunxi"

PREFERRED_PROVIDER_jpeg = "libjpeg-turbo"
PREFERRED_PROVIDER_jpeg-native = "libjpeg-turbo-native"

PREFERRED_PROVIDER_os-release = "calaos-version"
RDEPENDS_kernel-base = ""
```
